## camera-line-follow-test/main/Kconfig.projbuild
```kconfig
menu "Car wireless debug"
    config CAR_XIAOZHI
        bool "XiaoZhi manual voice session over saved Wi-Fi"
        depends on CAR_WIFI_DEBUG
        default y
        help
            Restores saved station credentials for cloud voice access.
            No automatic recording, movement or firmware upgrades.
    config CAR_WIFI_DEBUG
        bool "Wi-Fi camera dashboard (motors disabled)"
        default n
        help
            Starts a password-protected AP and optional Wi-Fi station.
            Publishes annotated vision frames and detection results over HTTP.
            Motor navigation and odometry are not initialized in this mode.
    config CAR_WIFI_RESTORE_STATION
        bool "Automatically reconnect saved external Wi-Fi on boot"
        depends on CAR_WIFI_DEBUG
        default n
        help
            Disabled for UART-only audio bring-up. Keeps saved credentials,
            but does not connect to the previous phone hotspot on boot.
endmenu
```

## number recognition/sdkconfig.defaults
```kconfig
CONFIG_IDF_TARGET="esp32s3"
CONFIG_ESP_CONSOLE_UART_DEFAULT=y
CONFIG_ESP_CONSOLE_SECONDARY_NONE=y
CONFIG_ESPTOOLPY_FLASHSIZE_32MB=y
CONFIG_ESPTOOLPY_MONITOR_BAUD=115200
CONFIG_ESP_DEFAULT_CPU_FREQ_MHZ_240=y
CONFIG_USB_HOST_CONTROL_TRANSFER_MAX_SIZE=3000
CONFIG_USB_HOST_HW_BUFFER_BIAS_IN=y
CONFIG_SPIRAM=y
CONFIG_SPIRAM_MODE_OCT=y
CONFIG_SPIRAM_TYPE_AUTO=y
CONFIG_SPIRAM_SPEED_80M=y
CONFIG_SPIRAM_MALLOC_RESERVE_INTERNAL=150000
# CONFIG_JD_USE_ROM is not set
CONFIG_JD_FORMAT_RGB565=y
CONFIG_JD_USE_SCALE=y
CONFIG_JD_FASTDECODE_32BIT=y
CONFIG_JD_DEFAULT_HUFFMAN=y
```

## tft-display-test/sdkconfig.defaults
```kconfig
CONFIG_IDF_TARGET="esp32s3"
CONFIG_ESP_CONSOLE_USB_SERIAL_JTAG=y
CONFIG_ESP_CONSOLE_SECONDARY_NONE=y
CONFIG_ESPTOOLPY_FLASHSIZE_32MB=y
CONFIG_ESPTOOLPY_MONITOR_BAUD=115200
```

## three-wheel-odometry-test/sdkconfig.defaults
```kconfig
CONFIG_IDF_TARGET="esp32s3"
CONFIG_ESP_CONSOLE_UART_DEFAULT=y
CONFIG_ESP_CONSOLE_SECONDARY_NONE=y
CONFIG_ESPTOOLPY_OCT_FLASH=y
# CONFIG_ESPTOOLPY_FLASH_MODE_AUTO_DETECT is not set
CONFIG_ESPTOOLPY_FLASHMODE_OPI=y
CONFIG_ESPTOOLPY_FLASH_SAMPLE_MODE_STR=y
CONFIG_ESPTOOLPY_FLASHFREQ_80M=y
CONFIG_ESPTOOLPY_FLASHSIZE_32MB=y
CONFIG_ESPTOOLPY_MONITOR_BAUD=115200
CONFIG_ESP_DEFAULT_CPU_FREQ_MHZ_240=y
```
